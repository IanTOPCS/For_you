#include "sys.h"
#include "delay.h"
#include "usart.h"
#include "led.h"
#include "lcd.h"
#include "24cxx.h"
#include "key.h"  
#include "myiic.h"

//ALIENTEK 探索者STM32F407開發板 實驗24
//IIC 實驗 --庫函數版本
//技術支持：www.openedv.com
//淘寶店舖：http://eboard.taobao.com  
//廣州市星翼電子科技有限公司  
//作者：正點原子 @ALIENTEK

// student-id
unsigned char Bmp001[]=
{
/*------------------------------------------------------------------------------
; If font display distortion, please check Fonts format of setup.
; Source file / text :01257027
; Width x Height (pixels) :128X32
;  Font Format/Size : Monochrome LCD Fonts ,Vertical scan ,  Little endian order/512Byte
;  Font make date  : 2026/3/19 ?? 05:12:02
------------------------------------------------------------------------------*/
//Width pixels,Height pixels,Width bytes
0x00,0x00,0x00,0x00,0x00,0x00,0x80,0x80,0x80,0x80,0x00,0x00,0x00,0x00,0x00,0x00,
0x00,0x00,0x00,0x00,0x00,0x00,0x00,0x80,0x80,0x00,0x00,0x00,0x00,0x00,0x00,0x00,
0x00,0x00,0x00,0x00,0x00,0x80,0x80,0x80,0x80,0x80,0x00,0x00,0x00,0x00,0x00,0x00,
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0x00,0x00,0x00,0x00,0x00,0x00,0x0C,0x0F,0x07,0x00,0x00,0x00,0x00,0x00,0x00,0x00,
};

// chinese name
unsigned char Bmp002[]=
{
/*------------------------------------------------------------------------------
; If font display distortion, please check Fonts format of setup.
; Source file / text :???
; Width x Height (pixels) :128X32
;  Font Format/Size : Monochrome LCD Fonts ,Vertical scan ,  Little endian order/512Byte
;  Font make date  : 2026/3/19 ?? 05:21:12
------------------------------------------------------------------------------*/
0x00,0x00,0x00,0x00,0x00,0x00,0x00,0x00,0x00,0xC0,0xC0,0xC0,0xC0,0xC0,0xC0,0xFF,
0xFF,0xC0,0xC0,0xC0,0xC0,0xC0,0x00,0xC0,0xC0,0xC0,0xC0,0xC0,0xC0,0xFF,0xFF,0xC0,
0xC0,0xC0,0xC0,0xC0,0xC0,0xC0,0x00,0x00,0x00,0x00,0x00,0x00,0x00,0x00,0x00,0x00,
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0x00,0x00,0x00,0x00,0x00,0x00,0x00,0x00,0x00,0x00,0x00,0x00,0x00,0x00,0x00,0x00,
};




//要寫入到24c02的字符串數組
const u8 TEXT_Buffer[]={"Explorer STM32F4 IIC TEST"};
#define SIZE sizeof(TEXT_Buffer)	 



void OLED_Bmp001()
{
u16 i,j;	
		
		for(i=0;i<=3;i++)
		{
			OLED_Set_Pos(0,i);
			for(j=0;j<128;j++)
			{
					OLED_WR_Byte(Bmp001[i*128+j],OLED_DATA);
			}
		}
	
}

void OLED_Bmp002()
{
u16 i,j;	
		
		for(i=0;i<=3;i++)
		{
			OLED_Set_Pos(0,i+4);
			for(j=0;j<128;j++)
			{
					OLED_WR_Byte(Bmp002[i*128+j],OLED_DATA);
			}
		}
	
}


int main(void)
{ 
	u8 key;
	u8 datatemp[SIZE];	
	NVIC_PriorityGroupConfig(NVIC_PriorityGroup_2);//設置系統中斷優先級分組2
	delay_init(168);    //初始化延時函數
	uart_init(115200);	//初始化串口波特率為115200
	
	LED_Init();					//初始化LED 
 	LCD_Init();					//LCD初始化 
	KEY_Init(); 				//按鍵初始化  
	AT24CXX_Init();			//IIC初始化 
	IIC1_Init();
	OLED_Init();
	LCD_Clear(BLACK);
 	POINT_COLOR=RED; 
	LCD_ShowString(30,50,200,16,16,"Explorer STM32F4");	
	LCD_ShowString(30,70,200,16,16,"IIC TEST");	
	LCD_ShowString(30,90,200,16,16,"ATOM@ALIENTEK");
	LCD_ShowString(30,110,200,16,16,"2014/5/6");	 
	LCD_ShowString(30,130,200,16,16,"KEY1:Write  KEY0:Read");	//顯示提示信息		
 	while(AT24CXX_Check())//檢測不到24c02
	{
		LCD_ShowString(30,150,200,16,16,"24C02 Check Failed!");
		delay_ms(500);
		LCD_ShowString(30,150,200,16,16,"Please Check!      ");
		delay_ms(500);
		LED0=!LED0;//DS0閃爍
	}
	LCD_ShowString(30,150,200,16,16,"24C02 Ready!");    
 	POINT_COLOR=BLUE;//設置字體為藍色	  
	
	OLED_Bmp001();
	OLED_Bmp002();
	while(1)
	{
		key=KEY_Scan(0);
		if(key==KEY1_PRES)//KEY1按下,寫入24C02
		{
			LCD_Fill(0,170,239,319,BLACK);//清除半屏    
 			LCD_ShowString(30,170,200,16,16,"Start Write 24C02....");
			AT24CXX_Write(0,(u8*)TEXT_Buffer,SIZE);
			LCD_ShowString(30,170,200,16,16,"24C02 Write Finished!");//提示傳送完成
		}
		if(key==KEY0_PRES)//KEY0按下,讀取字符串並顯示
		{
 			LCD_ShowString(30,170,200,16,16,"Start Read 24C02.... ");
			AT24CXX_Read(0,datatemp,SIZE);
			LCD_ShowString(30,170,200,16,16,"The Data Readed Is:  ");//提示傳送完成
			LCD_ShowString(30,190,200,16,16,datatemp);//顯示讀到的字符串
		}
		delay_ms(10);
	} 	    
}
