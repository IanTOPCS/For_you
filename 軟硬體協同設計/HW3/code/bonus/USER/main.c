#include "sys.h"
#include "delay.h"
#include "usart.h"
#include "led.h"
#include "lcd.h"
#include "24cxx.h"
#include "key.h"  
#include "myiic.h"
#include "timer.h"
#include "exti.h"
#include "stdbool.h"

// student-id
unsigned char Bmp001[] = {
/*------------------------------------------------------------------------------
; If font display distortion, please check Fonts format of setup.
; Source file / text :01257027
; Width x Height (pixels) :128X32
;  Font Format/Size : Monochrome LCD Fonts ,Vertical scan ,  Little endian order/512Byte
;  Font make date  : 2026/3/19 ?? 05:12:02
------------------------------------------------------------------------------*/
//Width pixels,Height pixels,Width bytes
0x00,0x00,0x00,0x00,0x00,0x00,0x80,0x80,0x80,0x80,0x00,0x00,0x00,0x00,0x00,0x00,
0x00,0x00,0x00,0x00,0x00,0x00,0x00,0x80,0x80,0x00,0x00,0x00,0x00,0x00,0x00,0x00,
0x00,0x00,0x00,0x00,0x00,0x80,0x80,0x80,0x80,0x80,0x00,0x00,0x00,0x00,0x00,0x00,
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0x00,0x00,0x00,0x00,0x00,0x00,0x0C,0x0F,0x07,0x00,0x00,0x00,0x00,0x00,0x00,0x00,
};

// chinese name
unsigned char Bmp002[] = {
/*------------------------------------------------------------------------------
; If font display distortion, please check Fonts format of setup.
; Source file / text :林承羿
; Width x Height (pixels) :128X32
;  Font Format/Size : Monochrome LCD Fonts ,Vertical scan ,  Little endian order/512Byte
;  Font make date  : 2026/3/19 ?? 05:21:12
------------------------------------------------------------------------------*/
0x00,0x00,0x00,0x00,0x00,0x00,0x00,0x00,0x00,0xC0,0xC0,0xC0,0xC0,0xC0,0xC0,0xFF,
0xFF,0xC0,0xC0,0xC0,0xC0,0xC0,0x00,0xC0,0xC0,0xC0,0xC0,0xC0,0xC0,0xFF,0xFF,0xC0,
0xC0,0xC0,0xC0,0xC0,0xC0,0xC0,0x00,0x00,0x00,0x00,0x00,0x00,0x00,0x00,0x00,0x00,
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0x00,0x00,0x00,0x00,0x00,0x00,0x00,0x00,0x00,0x00,0x00,0x00,0x00,0x00,0x00,0x00,
};

u16 len = 128, height = 4;
bool stopContinue = 0, stdIdFg = 1, stdNameFg = 0, lrOrUd = 0;

void OLED_Bmp001(void);
void OLED_Bmp002(void);
void shiftBlock(unsigned char*, bool);

int main(void) {
	NVIC_PriorityGroupConfig(NVIC_PriorityGroup_2);
	delay_init(168);
	uart_init(115200);
	
	LED_Init();
	LCD_Init();
	LCD_Clear(BLACK);
	AT24CXX_Init();
	IIC1_Init();
	KEY_Init();
	OLED_Init();
	EXTIX_Init();
	// timer 3 is 84M, 84M/8400=10Khz, 500*10Hz=50ms
	TIM3_Int_Init(500-1,8400-1);

	while(1) {
		
	}
	return 0;    
}

// timer 3 interrupt
void TIM3_IRQHandler(void) {
	if(TIM_GetITStatus(TIM3,TIM_IT_Update)==SET) {
		if (stopContinue == 0) {
			OLED_Bmp001();
			OLED_Bmp002();
			// shift Bmp001(student-id) to right
			shiftBlock(Bmp001, stdIdFg);
			// shift Bmp002(name) to left
			shiftBlock(Bmp002, stdNameFg);
		}
	}
	TIM_ClearITPendingBit(TIM3,TIM_IT_Update);
}

// for chinese name (to left)
void OLED_Bmp001() {
	u16 i,j;
	for(i=0; i<height; i++) {
		OLED_Set_Pos(0,i);
		for(j=0;j<len;j++) {
			OLED_WR_Byte(Bmp001[i*len+j],OLED_DATA);
		}
	}
}

// for student-id (to right)
void OLED_Bmp002() {
	u16 i,j;
	for(i=0; i<height; i++) {
		OLED_Set_Pos(0,i+height);
		for(j=0;j<len;j++) {
			OLED_WR_Byte(Bmp002[i*len+j],OLED_DATA);
		}
	}
}

// mode 0: left, 1: right
void shiftBlock(unsigned char* sor, bool mode) {
    u16 i, col, offset, row;
    unsigned char tmp;
	// adjust left-right
	if (lrOrUd == 0) {
		for (i = 0; i < height; i++) {
			// get begin of row
			offset = i * len;
			// shift left
			if (mode == 0) {
				tmp = sor[offset];
				// cover from next one
				for (col = 0; col < (len-1); col++) {
					sor[offset + col] = sor[offset + col + 1];
				}
				// set the last one
				sor[offset + (len-1)] = tmp;
			} else if (mode == 1) {
				// shift right
				// get last one
				tmp = sor[offset + (len-1)];
				// cover from back one
				for (col = (len-1); col > 0; col--) {
					sor[offset + col] = sor[offset + col - 1];
				}
				// set the first one
				sor[offset] = tmp;
			}
		}
	} else if (lrOrUd == 1) {
		// adjust up-down
		for(i = 0; i < len; i++) {
			// shift up
			if (mode == 0) {
				tmp = sor[i];
				for(row=0; row<(height-1); row++) {
					sor[(len*row) + i] = sor[(len*(row+1)) + i];
				}
				sor[i + (len*(height-1))] = tmp;

			} else if (mode == 1) {
				// shift down
				tmp = sor[i + (len*(height-1))];
				for(row=(height-1); row>0; row--) {
					sor[(len*row) + i] = sor[(len*(row-1)) + i];
				}
				sor[i] = tmp;
			}
		}
	}
	return;
}

// wake-up (0: continue, 1: stop)
void EXTI0_IRQHandler(void) {
	delay_ms(10);
	if(WK_UP==1) {
		stopContinue = !stopContinue;
		// let led0 shine when it stop
		if (stopContinue == 1) {
			LED0 = 0;
		} else LED0 = 1;
		// this fucking buttton is too old to use easely
		while(WK_UP == 1);
	}		 
	EXTI_ClearITPendingBit(EXTI_Line0);
}	


// key-2 adjust (0: left-right, 1: up-down)
void EXTI2_IRQHandler(void) {
	delay_ms(10);
	if(KEY2==0) {				 
   		lrOrUd = !lrOrUd;
	}		 
	EXTI_ClearITPendingBit(EXTI_Line2);
}

// key-1 student-name (0: left-up, 1: right-down)
void EXTI3_IRQHandler(void) {
	delay_ms(10);
	if(KEY1==0) {
		stdNameFg = !stdNameFg;
	}		 
	EXTI_ClearITPendingBit(EXTI_Line3);
}

// key-0 student-id (0: left-up, 1: right-down)
void EXTI4_IRQHandler(void) {
	delay_ms(10);
	if(KEY0==0) {				 
   		stdIdFg = !stdIdFg;
	}		 
	EXTI_ClearITPendingBit(EXTI_Line4);
}
