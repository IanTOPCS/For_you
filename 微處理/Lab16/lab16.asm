	ORG 0000H
	LJMP MAIN
	ORG 000BH
	LJMP T0ISR
	ORG 0013H
	LJMP EX1ISR

	ORG 0040H
MAIN:
	MOV R7, #10; MULTIPLE
	MOV R6, AR7
	MOV IE, #86H; ENABLE INTERRUPT TIME0 & EXTERNAL 0
	MOV TMOD, #02H
	MOV TH0, #0E2H;  30 MICRO SEC
	MOV TL0, #0FBH; INITIALIZE TIMER 0 LOW BYTE
	SETB TR0

	SETB IT1 ; INTERRUPT 1
	CLR P0.2; KEYBOARD R0W2

	SJMP $

FLASH_YELLOW:
	CPL P1.1
	RET

T0ISR:
	DEC R6
	MOV A, R6
	JNZ T0ISR_EXIT
	CALL FLASH_YELLOW
	MOV R6, AR7
T0ISR_EXIT:
	RETI

EX1ISR:
KEY4:
	JB P0.6, KEY5
	MOV A, R7
	CLR C
	SUBB A, #15
	JZ EX1ISR_EXIT
	INC R7
	JMP EX1ISR_EXIT
KEY5:
	JB P0.5, KEY6
	CPL TR0
	JMP EX1ISR_EXIT
KEY6:
	JB P0.4, EX1ISR_EXIT
	MOV A, R7
	CLR C
	SUBB A, #5
	JZ EX1ISR_EXIT
	DEC R7
EX1ISR_EXIT:
	RETI
